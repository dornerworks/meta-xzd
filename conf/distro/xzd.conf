## conf/distro/xzd.conf
```bitbake
require conf/distro/petalinux.conf

DISTRO = "xzd"
DISTRO_NAME = "XenZynq"
DISTRO_VERSION = "2019.1"
SDK_VENDOR = "-dw"
SDK_VERSION := "${@'${DISTRO_VERSION}'.replace('snapshot-${DATE}','snapshot')}"

MAINTAINER = "DornerWorks <xzd-support@dornerworks.com>"

TARGET_VENDOR = "-dw"

POKY_DEFAULT_DISTRO_FEATURES = "largefile ptest multiarch"

# microblaze is not supported.  Clear its distro features setting
DISTRO_FEATURES_DEFAULT_microblaze = ""

# Needed to elimnate libmali-xlnx dependency, since the repo link is broken
DISTRO_FEATURES_remove = "wayland"
```

## conf/layer.conf
```bitbake
# We have a conf and classes directory, add to BBPATH
BBPATH .= ":${LAYERDIR}"

# We have a packages directory, add to BBFILES
BBFILES += " \
		${LAYERDIR}/recipes-*/*/*.bb \
		${LAYERDIR}/recipes-*/*/*.bbappend"

BBFILE_COLLECTIONS += "xzd"
BBFILE_PRIORITY_xzd = "5"
BBFILE_PATTERN_xzd := "^${LAYERDIR}/"

LAYERDEPENDS_xzd = "core"
LAYERDEPENDS_xzd += "petalinux"
LAYERDEPENDS_xzd += "virtualization-layer"

SIGGEN_EXCLUDERECIPES_ABISAFE += " \
	gcc-cross-xilinx \
	binutils-cross-xilinx \
	"
BB_DANGLINGAPPENDS_WARNONLY = "true"

LAYERSERIES_COMPAT_xzd = "thud"
```

## conf/local.conf.sample
```bitbake
# Default Machine Selection
#
# XZD only runs on zynqmp machines
MACHINE ??= "zcu102-zynqmp"
# MACHINE ??= "ultrazed-zynqmp"

# XZD is derived from Petalinux so default to its policy.
DISTRO ?= "xzd"

# Disable additional language support
IMAGE_LINGUAS = ""

# Build the xzd initramfs
INITRAMFS_IMAGE = "xzd-image-minimal-initramfs"

# Bundle the initramfs with the kernel
INITRAMFS_IMAGE_BUNDLE = "1"

# The initramfs is kind of big
INITRAMFS_MAXSIZE = "524288"

# RPM same as the petalinux default
PACKAGE_CLASSES ?= "package_rpm"

# Yocto default
EXTRA_IMAGE_FEATURES = "debug-tweaks"

# Collect build statistics and reduce shared library file sizes
USER_CLASSES ?= "buildstats image-mklibs"

# Disable interactive patch resolution
PATCHRESOLVE = "noop"

# Shutdown if < 1GiB of Space or 100K inodes in (/tmp, TMPDIR, DL_DIR, SSTATE_DIR)
#
# Abort if < 100 MiB or 1K inodes.
BB_DISKMON_DIRS = "\
    STOPTASKS,${TMPDIR},1G,100K \
    STOPTASKS,${DL_DIR},1G,100K \
    STOPTASKS,${SSTATE_DIR},1G,100K \
    STOPTASKS,/tmp,100M,100K \
    ABORT,${TMPDIR},100M,1K \
    ABORT,${DL_DIR},100M,1K \
    ABORT,${SSTATE_DIR},100M,1K \
    ABORT,/tmp,10M,1K"

# Version Tracking
CONF_VERSION = "1"

# The Xilinx tools version we're targeting
XILINX_VER_MAIN = "2019.1"

#specify BIF partition attributes required for BOOT.bin
BIF_PARTITION_ATTR= "fsbl pmu atf u-boot bitstream"

#FSBL
BIF_PARTITION_ATTR[fsbl]="bootloader, destination_cpu=a53-0"
BIF_PARTITION_IMAGE[fsbl]="${DEPLOY_DIR_IMAGE}/fsbl-${MACHINE}.elf"
BIF_PARTITION_DEPENDS[fsbl]="virtual/fsbl:do_deploy"

#PMU
BIF_PARTITION_ATTR[pmu]="destination_cpu=pmu"
BIF_PARTITION_IMAGE[pmu]="${DEPLOY_DIR_IMAGE}/pmu-firmware-${MACHINE}.elf"
BIF_PARTITION_DEPENDS[pmu] ?= "virtual/pmu-firmware:do_deploy"

#ATF
BIF_PARTITION_ATTR[atf]="destination_cpu=a53-0,exception_level=el-3,trustzone"
BIF_PARTITION_IMAGE[atf]="${DEPLOY_DIR_IMAGE}/arm-trusted-firmware.elf"
BIF_PARTITION_DEPENDS[atf]="arm-trusted-firmware:do_deploy"

#U-boot
BIF_PARTITION_ATTR[u-boot]="destination_cpu=a53-0,exception_level=el-2"
BIF_PARTITION_IMAGE[u-boot]="${DEPLOY_DIR_IMAGE}/u-boot-${MACHINE}.elf"
BIF_PARTITION_DEPENDS[u-boot]="virtual/bootloader:do_deploy"

#Bitstream
BIF_PARTITION_ATTR[bitstream] ?= "destination_device=pl"
BIF_PARTITION_IMAGE[bitstream] ?= "${DEPLOY_DIR_IMAGE}/download-${MACHINE}.bit"
BIF_PARTITION_DEPENDS[bitstream] ?= "virtual/bitstream:do_deploy"
```

## conf/machine/ultrazed-zynqmp.conf
```bitbake
#@TYPE: Machine
#@NAME: zynqmp-ultrazed
#@DESCRIPTION: Machine support for UltraZed EG Starter Kit SOM and Carrier Card.
#

require conf/machine/include/tune-zynqmp.inc
require conf/machine/include/machine-xilinx-default.inc
require conf/machine/include/machine-xilinx-board.inc

MACHINE_FEATURES = "rtc ext2 ext3 vfat usbhost qemu-system-xilinx"

# UBOOT_MACHINE = "xilinx_zynqmp_zcu102_revB_defconfig"
UBOOT_MACHINE = "xilinx_zynqmp_ultrazed_defconfig"

SERIAL_CONSOLE = "115200 ttyPS0"

KERNEL_DEVICETREE = "xilinx/zynqmp-zcu102-revB.dtb"
```
