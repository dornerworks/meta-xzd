/*
 * dts file for Xilinx ZynqMP ZCU102 Board Running Xen
 *
 * Copyright (c) 2017 DornerWorks
 *
 * Permission is hereby granted, free of charge, to any person obtaining a copy
 * of this software and associated documentation files (the "Software"), to deal
 * in the Software without restriction, including without limitation the rights
 * to use, copy, modify, merge, publish, distribute, sublicense, and/or sell
 * copies of the Software, and to permit persons to whom the Software is
 * furnished to do so, subject to the following conditions:
 *
 * The above copyright notice and this permission notice shall be included in
 * all copies or substantial portions of the Software.
 *
 * THE SOFTWARE IS PROVIDED "AS IS", WITHOUT WARRANTY OF ANY KIND, EXPRESS OR
 * IMPLIED, INCLUDING BUT NOT LIMITED TO THE WARRANTIES OF MERCHANTABILITY,
 * FITNESS FOR A PARTICULAR PURPOSE AND NONINFRINGEMENT. IN NO EVENT SHALL THE
 * AUTHORS OR COPYRIGHT HOLDERS BE LIABLE FOR ANY CLAIM, DAMAGES OR OTHER
 * LIABILITY, WHETHER IN AN ACTION OF CONTRACT, TORT OR OTHERWISE, ARISING FROM,
 * OUT OF OR IN CONNECTION WITH THE SOFTWARE OR THE USE OR OTHER DEALINGS IN
 * THE SOFTWARE.
 */
#include "zynqmp-zcu102-revB.dts"

/ {
	model = "ZynqMP ZCU102 Xen";

   chosen {
      bootargs = "earlycon=cdns,mmio,0xFF000000,115200n8";
      stdout-path = "serial0:115200n8";
      #address-cells = <0x2>;
      #size-cells = <0x1>;
      xen,xen-bootargs = "console=dtuart dtuart=serial0 dom0_mem=512M bootscrub=0 dom0_vcpus_pin maxcpus=2 timer_slop=0 dom0_max_vcpus=2";
	   xen,dom0-bootargs = "console=hvc0 earlycon=xen earlyprintk=xen rootdelay=1 root=/dev/ram devtmpfs.mount=1";

	   dom0 {
		   compatible = "xen,linux-zimage", "xen,multiboot-module";
		   reg = <0x0 0x80000 0x3100000>;
   	};
   };
};